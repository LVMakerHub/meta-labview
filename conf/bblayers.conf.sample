## conf/bblayers.conf.sample
```bitbake
# LAYER_CONF_VERSION is increased each time build/conf/bblayers.conf
# changes incompatibly
LCONF_VERSION = "6"

BBPATH = "${TOPDIR}"
BBFILES ?= ""

BBLAYERS ?= " \
  ../../meta \
  ../../meta-yocto \
  ../../meta-yocto-bsp \
  ../../meta-openembedded/meta-oe \
  ../../meta-labview \
  "
BBLAYERS_NON_REMOVABLE ?= " \
  ../../meta \
  ../../meta-yocto \
  "
```

## conf/layer.conf
```bitbake
# We have a conf and classes directory, append to BBPATH
BBPATH .= ":${LAYERDIR}"

# We have a recipes directory containing .bb and .bbappend files, add to BBFILES
BBFILES += "${LAYERDIR}/recipes*/*/*.bb \
            ${LAYERDIR}/recipes*/*/*.bbappend"

BBFILE_COLLECTIONS += "labview"
BBFILE_PATTERN_labview := "^${LAYERDIR}/"
BBFILE_PRIORITY_labview = "9"
```

## conf/machine/generic-armv7a.conf
```bitbake
#@TYPE: Machine
#@NAME: Generic ARM
#@DESCRIPTION: Machine configuration for generic armv7a boards.

DEFAULTTUNE ?= "armv7a"
require conf/machine/include/arm/arch-armv7a.inc

IMAGE_FSTYPES += "tar.gz ext4"
```
